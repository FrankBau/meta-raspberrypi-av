## conf/layer.conf
```bitbake
# We have a conf and classes directory, add to BBPATH
BBPATH .= ":${LAYERDIR}"

# We have recipes-* directories, add to BBFILES
BBFILES += "${LAYERDIR}/recipes-*/*/*.bb \
	    ${LAYERDIR}/recipes-*/*/*.bbappend"

BBFILE_COLLECTIONS += "raspberrypi-avg"
BBFILE_PATTERN_raspberrypi-avg = "^${LAYERDIR}/"
BBFILE_PRIORITY_raspberrypi-avg = "10"
```
